## conf/layer.conf
```bitbake
# We have a conf and classes directory, append to BBPATH
BBPATH .= ":${LAYERDIR}"

# We have a recipes directory, add to BBFILES
BBFILES += "${LAYERDIR}/recipes*/*/*.bb ${LAYERDIR}/recipes*/*/*.bbappend"

BBFILE_COLLECTIONS += "meta-sunxi64"
BBFILE_PATTERN_meta-sunxi64 := "^${LAYERDIR}/"
BBFILE_PRIORITY_meta-sunxi64 = "10"

# This should only be incremented on significant changes that will
# cause compatibility issues with other layers
LAYERVERSION_meta-sunxi64 = "1"

LAYERDEPENDS_meta-sunxi64 = "core"

LAYERSERIES_COMPAT_meta-sunxi64 = "kirkstone"
```

## conf/machine/include/sun50i.inc
```bitbake
require conf/machine/include/sunxi64.inc

SOC_FAMILY = "sun50i:sun50i${SOC_FAMILY_SUFFIX}"

DEFAULTTUNE ?= "cortexa53-crypto"
require conf/machine/include/arm/armv8a/tune-cortexa53.inc
```

## conf/machine/orange-pi-3-lts.conf
```bitbake
#@TYPE: Machine
#@NAME: orange-pi-3-lts
#@DESCRIPTION: Machine configuration for the orange-pi-3-lts, base on Allwinner H6 CPU

require conf/machine/include/sun50iw6.inc

KERNEL_DEVICETREE = "allwinner/sun50i-h6-orangepi-3-lts.dtb"
UBOOT_MACHINE = "orangepi_3_lts_defconfig"
```

## conf/machine/orange-pi-zero2.conf
```bitbake
#@TYPE: Machine
#@NAME: orange-pi-zero2
#@DESCRIPTION: Machine configuration for the orange-pi-zero2, base on Allwinner H616 CPU

require conf/machine/include/sun50iw9.inc

KERNEL_DEVICETREE = "allwinner/sun50i-h616-orangepi-zero2.dtb"
UBOOT_MACHINE = "orangepi_zero2_defconfig"
```
